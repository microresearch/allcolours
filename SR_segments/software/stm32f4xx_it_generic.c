/*

<--------------+-------^-------+-------<
               |       |       |       |
               |       |       |       |
               +-------+       +-------+

0  0  0  0  0  0  0  0  1  1  1  1  1  1  1  1  0  0  1  1  1  1  1  1  1  1  1  1  1  1  1  1  
0  0  0  0  0  0  0  0  0  1  1  1  1  1  1  1  1  0  0  1  1  1  1  1  1  1  1  1  1  1  1  1  
0  0  0  0  0  0  0  0  0  0  1  1  1  1  1  1  1  1  0  0  1  1  1  1  1  1  1  1  1  1  1  1  
0  0  0  0  0  0  0  0  0  0  0  1  1  1  1  1  1  1  1  0  0  1  1  1  1  1  1  1  1  1  1  1  
0  0  0  0  0  0  0  0  1  1  1  1  0  0  0  0  0  0  0  0  1  1  0  0  0  0  0  0  0  0  0  0  
0  0  0  0  0  0  0  0  0  1  1  1  1  0  0  0  0  0  0  0  0  1  1  0  0  0  0  0  0  0  0  0  
1  0  0  0  0  0  0  0  0  0  1  1  1  1  0  0  0  0  0  0  0  0  1  0  0  1  1  1  1  0  1  1  
1  0  0  0  0  0  0  0  0  0  0  1  1  1  1  0  0  0  0  0  0  0  0  1  0  0  1  1  1  1  0  1  
0  0  0  0  0  0  0  0  0  0  0  0  1  1  1  1  0  0  0  0  0  0  0  1  1  1  1  0  0  1  0  1  
0  0  0  0  0  0  0  0  0  0  0  0  0  1  1  1  1  0  0  0  0  0  0  0  1  1  1  1  0  0  1  0  
0  0  0  0  0  0  0  0  0  0  0  0  0  0  1  1  1  1  0  0  0  0  0  0  0  1  1  1  1  0  0  1  
0  0  0  0  0  0  0  0  0  0  0  0  0  0  0  1  1  1  1  0  0  0  0  0  0  0  1  1  1  1  0  0  
0  0  0  0  0  0  0  0  0  0  0  0  0  0  0  0  1  1  1  1  0  0  0  0  0  0  0  1  1  1  1  0  
0  0  0  0  0  0  0  0  0  0  0  0  0  0  0  0  0  1  1  1  1  0  0  0  0  0  0  0  1  1  1  1  
0  0  0  0  0  0  0  0  0  0  0  0  0  0  0  0  0  0  1  1  1  1  0  0  0  0  0  0  0  1  1  1  
0  0  0  0  0  0  0  0  1  1  1  1  1  1  1  1  1  1  1  0  0  0  0  1  1  1  1  1  1  1  0  0  
1  0  0  0  0  0  0  0  1  0  0  0  0  0  0  0  0  0  0  0  1  1  1  0  0  1  1  1  1  0  1  0  
1  0  0  0  0  0  0  0  1  0  1  1  1  1  1  1  1  1  1  1  1  0  0  0  1  1  0  0  0  0  1  0  
1  0  0  0  0  0  0  0  1  0  1  0  0  0  0  0  0  0  0  0  0  0  1  1  1  0  0  1  1  1  1  0  
1  0  0  0  0  0  0  0  0  1  0  1  0  0  0  0  0  0  0  0  0  0  0  1  1  1  0  0  1  1  1  1  

TODO:
////- this version used in Vienna 22/23/9/2021

  */ 

//#include "main.h"
#include "stm32f4xx.h"
#include "stm32f4xx_dac.h"
#include "stm32f4xx_gpio.h"
#include "stm32f4xx_adc.h"
#include "stm32f4xx_dma.h"
#include "stm32f4xx_rcc.h"
#include "stm32f4xx_spi.h"
#include "stm32f4xx_exti.h"
#include "stm32f4xx_tim.h"
#include "misc.h"
#include "adc.h"

/////////////////////
extern __IO uint16_t adc_buffer[12];
float LPF_Beta = 0.4; // 0<ß<1
uint32_t lookupadc[4]={0,3,9,6}; // CVs for speed

#define FULL 0b11111111111111111111111111111111 //32 bits full
#define FROZENSPEED 1024 // 
#define MAXVALUE 4095
#define SMOOTHINGS 512 // we can hold 65536 of our 16 bit ADC values...speed
uint32_t cc=0, totc=0, smoothc[SMOOTHINGS];
uint32_t ll=0, totl=0, smoothl[SMOOTHINGS];
uint32_t rr=0, totr=0, smoothr[SMOOTHINGS];
uint32_t nn=0, totn=0, smoothn[SMOOTHINGS];

uint16_t mode[4]={0,0,0,0};
uint8_t clkr=7;
uint16_t lastmodec, lastmoden, lastmodel, lastmoder;
uint16_t lastlastmodec, lastlastmoden, lastlastmodel, lastlastmoder;

volatile uint32_t intflag[4]={0,0,0,0}; // interrupt flag...
uint32_t SRlength[4]={31,31,31,31};

// for generic CLK fake puls routing
//LSRCLK-pulse9=PB12, RSRCLK-pulse10=PB13, CSRCLCK-pulse11=PB14
// 000,001,010,011,100,101,110,111
static uint32_t clk_route[8]={0,
			      (1<<12),
			      (1<<13),
			      (1<<12) | (1<<13),
			      (1<<14),
			      (1<<12) | (1<<14),
			      (1<<14) | (1<<13),
			      (1<<12) | (1<<13) | (1<<14)
};


// simplest generic shifter without counter and with one route!

static uint32_t shift_[4]={0xff,0xff,0xff,0xff};
static uint32_t Gshift_[4][4]={
  {0xff,0xff,0xff,0xff},
  {0xff,0xff,0xff,0xff},
  {0xff,0xff,0xff,0xff},
  {0xff,0xff,0xff,0xff}
};

static uint32_t GGshift_[4], cogg[4][4]; // gshift is 4 even though we don't use one
// GG is ghost in ghost

// and cycling/circling array of ghosts which can come back or go forwards/backwards - when these ghosts are copied over (on event)
// with 256 cycles/copies - or we can have variable length of this shifting array

uint32_t Gshift_rev[4][256], Gshift_revcnt[4]={0,0,0,0};

// simple modes: speedfrom, speedfrom_, inputbit, adctype, dactype, doit and route (some of these are fixed)
// route to itself, route from others
// TODO: basic structures, experiment with route bits from SRs, ghosts in ghosts and add in more esoteric modes
// small tweaks, changes for more diverse modes

// set of modes of how we interpret modes!!!
// 64 modes
//         32/16/8/4/2/1
//          1  1 1 1 1 1 - 6 bits

// 20.9.2021: route is 4 bits - 0->15 try quick mode->route
// inversion is 1 extra bit, speedfrom is one extra bit so 6 bits so far

// so for simple pass through by speed would be: speedfrom=0/inputbit=2/adctype=0/route=last one as bit/
uint32_t speedfrom[4]={1,0,0,0}; //0 is CV, 1 is interrupt, 2 is DACspeedfrom_ + CV
uint32_t speedfrom_[4]={0,0,0,0}; // who we get dac offset from?
uint32_t inputbit[4]={0,2,2,2}; //0-LFSR,1-ADC,2-none
uint32_t LFSR[4]={0,1,2,3}; // which SR take the LFSR bits from!
uint32_t adctype[4]={0,0,0,0}; // 0-basic, 1-one bit
uint32_t dactype[4]={0,0,2,0}; // 0-basic, 1-equiv bits, 2-one bit
uint32_t doit[4]={1,0,0,0}; // covers what we do with cycling bit - 0 nada, 1=invert if srdacvalue[x]<param// param is 12 bits - can be other options
uint32_t whichdoit[4]={8,8,8,8}; // dac from???

uint32_t route[4]={8,1,2,1}; // route[4]={1,9,9,9}; NLCR=1248 0->15
uint32_t logopp[4]={0,0,0,0};

volatile uint32_t prev_stat[4]={0,0,0,0};
volatile uint32_t speed[4]={0,0,0,0};
volatile uint32_t dac[4]={0,0,0,0};
volatile uint32_t adc_[4]={0,0,0,0};
uint32_t counter_[4]={0,0,0,0};

// what are pulse ins?
// only for left and right! PC7 is RSR, PC8 is LSR
// generic table and all on GPIOC
static uint32_t pulsins[4]={0,1<<8,0,1<<7}; //N,L,C,R

// what are pulse outs?
// L1-PB2, L2-PC15, R1-PB3, R2-PA11, C1-PB4, C2-PA12
static uint32_t pulsouts[8]={0, 0, 1<<2,1<<15, 1<<4,1<<12, 1<<3,1<<11};

// test pointering WORKS! so we can have array of pointers for easier bit access
//also we can make bit access (eg. GPIOC->IDR & 0x0010 - can we access register as pointer TEST???, counters speed etc. all arrays 0,1,2,3
//  volatile uint32_t *bitz;
//  bitz=&(GPIOC->IDR);

volatile uint16_t *pulsoutHI[8]={&(GPIOB->BSRRL), &(GPIOB->BSRRL), &(GPIOB->BSRRL), &(GPIOC->BSRRL), &(GPIOB->BSRRL), &(GPIOA->BSRRL), &(GPIOB->BSRRL), &(GPIOA->BSRRL) };
//                                  0              0              PB2            PC15           PB4            PA12           PB3            PA11 
volatile uint16_t *pulsoutLO[8]={&(GPIOB->BSRRH), &(GPIOB->BSRRH), &(GPIOB->BSRRH), &(GPIOC->BSRRH), &(GPIOB->BSRRH), &(GPIOA->BSRRH), &(GPIOB->BSRRH), &(GPIOA->BSRRH) }; // both are 16 bit registers

static uint8_t lookuplenall[32]={3, 3, 3, 3, 4,5,6,7,8,9,10,11,12,13,14,15,16,17,18,19,20,21,22,23,24,25,26,27,28,29,30,31};

static uint8_t bitsz[256]={0, 1, 1, 2, 1, 2, 2, 3, 1, 2, 2, 3, 2,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 7, 8}; // this is for 8 bits

static uint8_t rightshift[32]={0,0,0,0, 0,0,0,0, 0,0,0,0, // first 12 bits
				1,2,3,4, 5,6,7,8, 9,10,11,12, 13,14,15,16, 17,18,19,20};

static uint8_t leftshift[32]= {11,10,9, 8,7,6,5, 4,3,2,1,
				0,0,0,0, 0,0,0,0, 0,0,0,0, 0,0,0,0, 0,0,0,0};

// fixed masks 31/8/2021

static uint32_t invmasky[32]={//0,0,0, // skip all zeroes or all ones ??? skip all ones

  //0b11111111111111111111111111111111,
0b11111111111111111111111111111110,
0b11111111111111111111111111111100,
0b11111111111111111111111111111000,
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0b10000000000000000000000000000000,
0b00000000000000000000000000000000
};

  
static uint32_t masky[32]={//0,0,0, // skip all zeroes or all ones ??? all 0
			   0b00000000000000000000000000000001,			  
			   0b00000000000000000000000000000011,			  
			   0b00000000000000000000000000000111,			  
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			   0b11111111111111111111111111111111,
};

static uint32_t othermasky[32]={  // skip all zeroes or all ones ???
  //  0b00000000000000000000000000000000,
  0b10000000000000000000000000000000,
  0b11000000000000000000000000000000,
  0b11100000000000000000000000000000,
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  0b11111111111111111111111111111111,
};


// TODO: test much greater range of slow speeds - and stop indicator/value at end -> first establish basic speed for all modes and then
// we can do this...

static uint16_t logger[1024]={1, 1, 1, 1, 1, 1, 1, 1, 1, 1, 1, 1, 1,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 1017, 1024}; //

// array for taps
// eg. 32-bit Galois LFSR with taps at 32, 30, 26, 25. Sequence length is 4294967295. 0 is a lock-up state.  -- minus one here - 31, 29, 25, 24
// bith= ((shift_registerh >> 31) ^ (shift_registerh >> 29) ^ (shift_registerh >> 25) ^ (shift_registerh >> 24)) & 1u; // 32 is 31, 29, 25, 24
// from: http://courses.cse.tamu.edu/walker/csce680/lfsr_table.pdf
// and reworked for length in test.c -> not so if we revert to basic code...
// note that we can have 2 mirrored with [n, A, B, C] -> [n, n-C, n-B, n-A] - maybe for LF to hF!

static uint8_t lfsr_taps[32][4] = {
        {0, 0, 0, 0},
        {0, 0, 0, 0},
        {0, 0, 0, 0},
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        {31, 29, 25, 24},
  };

static uint8_t ghost_tapsL[32][4] = { // left hand path
        {0, 0, 0, 0},
        {0, 0, 0, 0},
        {0, 0, 0, 0},
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        {31, 29, 25, 24},
  };


static uint8_t lfsr_taps_mirrored[32][4] = {
        {0, 0, 0, 0},
        {0, 0, 0, 0},
        {0, 1, 1, 1},
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        {31, 6, 5, 1},
	 };

static uint8_t ghost_tapsR[32][4] = { // right hands path
        {0, 0, 0, 0},
        {0, 0, 0, 0},
        {0, 1, 1, 1},
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        {31, 6, 5, 1},
	 };

static uint8_t countbts[4096]={0, 1, 1, 2, 1, 2, 2, 3, 1, 2, 2, 3, 2,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 11, 12};

uint32_t divy[12]={4096, 2048, 1365, 1024, 819, 682, 585, 512, 455, 409, 372, 341};

// TODO: generic ADC functions for bit insertions into shift registers! - for single bits only we return bit which is to be used here

static inline int ADC_(uint32_t reg, uint32_t length, uint32_t type){ // here we use length as number of bits max is 12 bits
  static uint8_t n[4]={0,0,0,0}; // counters
  static int32_t integrator=0, oldValue=0;

  static uint32_t k; // 21/9 - we didn't have k for one bits as static - FIXED/TEST!
  int bt;

  if (type==0){ // basic sequential length of bits cycling in
  if (length>11) length=11;
      if (n[reg]==length) {
	k=(adc_buffer[12])>>(11-length); //
      n[reg]=0;
    }
    bt = (k>>n[reg])&0x01;
    n[reg]++;    
  }
  else { // one bit audio input
    n[reg]++;
  if (n[reg]>50) {
    k=(adc_buffer[12]); // now 12 bits only // 16 bits to 12 bits - this is now our ADCin!
    n[reg]=0;
  }

  integrator+=k-oldValue;
   if(integrator>0)
  {
     oldValue=MAXVALUE;
     bt=1;
  }
   else
   {
      oldValue=0;
      bt=0;
   }

    // other options are: comparator, equivalent sets of x bits incoming (how to do this cleanly for x number of bits)

    }
    
    return bt;
}


//bitr=logop(bitr,bitrr,logopp[w]); // or other op TODO
static inline uint32_t logop(uint32_t bita, uint32_t bitaa, uint32_t type){ //TODO: xor, or, and, leaky, others?
  // for now is just XOR
  return (bita ^ bitaa);
  
}
  
static inline uint32_t DAC_(uint32_t reg, uint32_t length, uint32_t type){ // 3 types 0,1,2 - but we can also add more types for spacings with array of spacers (which we
                                                                      // did have somewhere
  uint32_t y,x=0;
  static float SmoothData[4]={0.0, 0.0, 0.0, 0.0};

  if (type==0){ // standard bit DAC for x bits
    //    if (reg<4 && length>3 && length<32) 
      x=((shift_[reg] & masky[length-3])>>(rightshift[length-3]))<<leftshift[length-3]; // we want 12 bits but is not really audible difference    
  }
  else if (type==1){
      // equivalent bit DAC for x bits - we need a table for this!
      // or more like set of tables for each bit
      // and we need divide highest but number - eg. for 8 bits we have max 8 (all 1s) - max 12 bits DAC is 4096 4096/8=512 4096/12=341
      // we can have another table for this - but just taking maybe max of 12 bits otherwise lookup is too long (max 12 bits=4096)
    //      if (reg<4){
	if (length>11) length=11;
	x=countbts[shift_[reg]&masky[length]]; // lower length bits only
	y=4096/(length+1);
	  x*=y;
	  //      }
  }
  else { // one bit audio
    // top bit
    y=(shift_[reg]>>length)&1;
    if (y==1) x=4095;
    else x=0;
    SmoothData[reg] = SmoothData[reg] - (LPF_Beta * (SmoothData[reg] - x)); // how do we adjust beta for speed?
    x=(int)SmoothData[reg];
  }
  return x;
}



///////////////////////////////////////////////////////////////////////// 

#define delay()						 do {	\
    register unsigned int ix;					\
    for (ix = 0; ix < 1000; ++ix)				\
      __asm__ __volatile__ ("nop\n\t":::"memory");		\
  } while (0)

#define delayy()						 do {	\
    register unsigned int ix;					\
    for (ix = 0; ix < 10000000; ++ix)				\
      __asm__ __volatile__ ("nop\n\t":::"memory");		\
  } while (0)

void NMI_Handler(void)
{
}

void HardFault_Handler(void)
{
  /* Go to infinite loop when Hard Fault exception occurs */
  while (1)
  {
  }
}

void MemManage_Handler(void)
{
  /* Go to infinite loop when Memory Manage exception occurs */
  while (1)
  {
  }
}

void BusFault_Handler(void)
{
  /* Go to infinite loop when Bus Fault exception occurs */
  while (1)
  {
  }
}

void UsageFault_Handler(void)
{
  /* Go to infinite loop when Usage Fault exception occurs */
  while (1)
  {
  }
}

void SVC_Handler(void)
{
}

void DebugMon_Handler(void)
{
}

void PendSV_Handler(void)
{
}

void EXTI4_IRQHandler(void){ // working NSR 
  uint32_t tmp, tmpp;
if (EXTI_GetITStatus(EXTI_Line4) != RESET) {
  intflag[0]=1; //NSR
  counter_[0]++; // overflow at 32 bits
  EXTI_ClearITPendingBit(EXTI_Line4);
 }
 }

void EXTI9_5_IRQHandler(void){ // PC5 RSR works and PB6 LSR share same line but both work out
  uint32_t tmp, tmpp;
  uint16_t j, bit, xx, x;
  uint32_t lengthbitl=15, new_statl, new_statr,new_statc, lengthbitc=15, lengthbitr=15; // for 2nd bit on lsr, rsr and csr
  
  // added PB7 now for CSRCLKIN CSR which moved from PC3!!!
  // CSR: PC3->now PB7, NSR: PC4, RSR: PC5, LSR: PB6
  
  
  if (EXTI_GetITStatus(EXTI_Line5) != RESET) { //RSR  
    intflag[3]=1; //RSR
    counter_[3]++; // overflow at 32 bits
    EXTI_ClearITPendingBit(EXTI_Line5);
 }

  if (EXTI_GetITStatus(EXTI_Line6) != RESET) { //LSR
    intflag[1]=1; //LSR
  counter_[1]++; // overflow at 32 bits

    EXTI_ClearITPendingBit(EXTI_Line6);
 } 

  if (EXTI_GetITStatus(EXTI_Line7) != RESET) {// CSR
    intflag[2]=1; //CSR
    counter_[2]++; // overflow at 32 bits
    EXTI_ClearITPendingBit(EXTI_Line7);
 } 

}

  uint16_t leaks(uint16_t x, uint16_t y, uint16_t prob, uint16_t who){ // try lazy, stickyt, leaky, decaying logic here... // who is new 20/9 for which SR we take logic from...
  static uint16_t timer=0;
  uint16_t z;
  // p as probability or time
  // keep track of how many times this is called (for each register) and flip bit

  // or we can track bits recording their position for a certain lifespan
  // one bit per SR is tracked and lost... so would be leakNSR for example for that bit
  
  // but that is too deterministic... but if we share timers or if timer is across different speeds
  //  prob=1;
  // leaky XOR to test
  if (prob>31) prob=31;
  
  if (x^y==0) return 0;
  //  shift_registerR=(shift_registerR<<1)+z; // we are shifting left << so bit 31 is out last one
  if ((shift_[who]&masky[prob])==0) return 1;
  //  else if (rand()%prob==0) return 1;
  return 0;
  
  /*  timer++;
  if (timer>p){
    timer=0;
    d^=1;
    }*/
}

void TIM4_IRQHandler(void) 
// HERE we do speed and modes ALL TODO AS ARRAYS

{
  uint32_t temp;
  volatile static uint16_t tmp;

  TIM_ClearITPendingBit(TIM4, TIM_IT_Update); 

  /*  
      tmp^=1;
      if (tmp) GPIOB->BSRRH = (1)<<4;  // clear bits PB2
      else   GPIOB->BSRRL=(1)<<4; //  write bits   
  */

    // map ADCs: note all modes are inverted

    // 0: nspd, 1: nlen, 2: nmode
    // 3: lspd, 4: llen, 5: lmode
    // 6: rspd, 7: rlen, 8: rmode // adc6 fixed hw
    // 9: cspd, 10: clen, 11: cmode

  // deal with PWM for normings (always follows speedn - or now we think it should follow DAC out)
  
  // double-check inversion of modes? as doesn't seem so!
  // modes are NOT inverted!
  
  //moden
  temp=(adc_buffer[2]+lastlastmoden+lastmoden)/3; //smoothing necessary for higher speeds - TEST!
  lastlastmoden=lastmoden;
  lastmoden=temp;
  mode[0]=(temp>>6); // 64 modes = 6 bits  

  // modec
  temp=(adc_buffer[11]+lastlastmodec+lastmodec)/3; //smoothing necessary for higher speeds - TEST!
  lastlastmodec=lastmodec;
  lastmodec=temp;
  mode[2]=(temp>>6); // 64 modes = 6 bits  

  // model
  temp=(adc_buffer[5]+lastlastmodel+lastmodel)/3; //smoothing necessary for higher speeds - TEST!
  lastlastmodel=lastmodel;
  lastmodel=temp;
  mode[1]=(temp>>6); // 64 modes = 6 bits  

  // moder
  temp=(adc_buffer[8]+lastlastmoder+lastmoder)/3; //smoothing necessary for higher speeds - TEST!
  lastlastmoder=lastmoder;
  lastmoder=temp;
  mode[3]=(temp>>6); // 64 modes = 6 bits  
  
  // speedn
  totn=totn-smoothn[nn];
  smoothn[nn]=adc_buffer[0];
  totn+=smoothn[nn];
  nn++;
  if (nn>=SMOOTHINGS) nn=0;
  temp=totn/SMOOTHINGS;  
  speed[0]=logger[temp>>2];

  // speedl
  totl=totl-smoothl[ll];
  smoothl[ll]=adc_buffer[3];
  totl+=smoothl[ll];
  ll++;
  if (ll>=SMOOTHINGS) ll=0;
  temp=totl/SMOOTHINGS;  
  speed[1]=logger[temp>>2];

  // speedr
  totr=totr-smoothr[rr];
  smoothr[rr]=adc_buffer[6];
  totr+=smoothr[rr];
  rr++;
  if (rr>=SMOOTHINGS) rr=0;
  temp=totr/SMOOTHINGS;  
  speed[3]=logger[temp>>2];

    // speedc
  totc=totc-smoothc[cc];
  smoothc[cc]=adc_buffer[9];
  totc+=smoothc[cc];
  cc++;
  if (cc>=SMOOTHINGS) cc=0;
  temp=totc/SMOOTHINGS;  
  speed[2]=logger[temp>>2];

  
  
  // lens from 4 to 32

  temp=31-(adc_buffer[1]>>7); // 12 bits to 5 bits 
  SRlength[0]=lookuplenall[temp];

  temp=31-(adc_buffer[4]>>7); // 12 bits to 5 bits 
  SRlength[1]=lookuplenall[temp];

  temp=31-(adc_buffer[7]>>7); // 12 bits to 5 bits 
  SRlength[3]=lookuplenall[temp];

  temp=31-(adc_buffer[10]>>7); // 12 bits to 5 bits 
  SRlength[2]=lookuplenall[temp];

}

void TIM2_IRQHandler(void) // running with period=1024, prescale=32 at 2KHz - how fast can we run this?
// period 32, prescaler 8 = toggle of 104 KHz
// 4 and 4 we go up to 800 KHz
{
  uint32_t lengthbit=15, new_stat;
  uint32_t x, y, q, start=0;
  uint32_t bitn, bitrr, tmp, param,xx;
  static uint32_t flipd[4]={0,0,0,0}, flipper=1, w=0;
  static uint32_t counter[4]={0,0,0,0};

  TIM_ClearITPendingBit(TIM2, TIM_IT_Update); // needed

  ////////////////////////////////////////////////////
  // ATTEMPTING: generic SR for most basic/nearly all cases
  // we can still have specialised ones but they should all be repeatable
  //
  // so also that each mode then has a code for: speedfrom/inputbit/adctype/route/ - later add in DAC etc.
  // so for simple pass through by speed would be: speedfrom=0/inputbit=2/adctype=0/route=last one as bit/
  ////////////////////////////////////////////////////
  // we need to start with defaults above

  // crash detect ++ 32/64 in main.c is 14KHz
  /*       flipper^=1;
     if (flipper) GPIOB->BSRRH = (1)<<4;  // clear bits PB2
     else   GPIOB->BSRRL=(1)<<4; //  write bits   
  */
  
  //      for (w=0;w<4;w++){ // otherwise timing is all off!
  w++;
  if (w>3) w=0;
  //1-Where do I get speed from? implement it!
  // cases are interrupt flag, CV, CV+DACroute

  counter[w]++;
  speedfrom[w]=mode[w]>>5; // top bit maybe

    if (w==2 && counter[2]>speed[w] && speedfrom[2]==1){ // 2 is Cspeed - but we have a problem when Cspeed is from an interrupt as this is never generated...FIXED HERE
      counter[2]=0;
      flipper^=1;
      if (flipper) GPIOB->BSRRH = clk_route[clkr];  // clear bits of fake_one - clkr is 7 so all of them
      // or we can set L and R from an independent SR with only CSR as clocked from here
      else   GPIOB->BSRRL=clk_route[clkr]; //  write bits       
    }
  
  if (speedfrom[w]==1 && intflag[w]==1){ // interrupt flag
    intflag[w]=0;
    start=1;
    param=adc_buffer[lookupadc[w]]; // we can use speed adc as is interrupt TODO
  }
  else if (speedfrom[w]==0 && counter[w]>speed[w]){
      counter[w]=0; 
      start=1;
      param=counter_[w]&masky[11]; // we use pulse counter as param - where to count this - lower 12 bits only as param is just 12 bits
      flipper^=1;
      if (flipper) GPIOB->BSRRH = clk_route[clkr];  // clear bits of fake_one - clkr is 7 so all of them
      // or we can set L and R from an independent SR with only CSR as clocked from here
      else   GPIOB->BSRRL=clk_route[clkr]; //  write bits       

  }
  // next is never used as we have one bit only for speedfrom
  else if (speedfrom[w]==2 && counter[w]>(speed[w]+dac[speedfrom_[w]])){ // add means we always slow down - other options (wrap, lookup)
      counter[w]=0; 
      start=1;
      param=counter_[w]&masky[11]; // we use pulse counter as param - where to count this - lower 12 bits only as param is just 12 bits
      flipper^=1;
      if (flipper) GPIOB->BSRRH = clk_route[clkr];  // clear bits of fake_one - clkr is 7 so all of them
      // or we can set L and R from an independent SR with only CSR as clocked from here
      else   GPIOB->BSRRL=clk_route[clkr]; //  write bits       
    }
  // also more cases eg. for AND with chosen SR bit!  
  if (start==1){ // all trigger one SR operation
    //2.1-deal with housekeeping    
    // speed from C for fake CLKINs

    // copy now to ghost
  //we need multiple ghosts for each possible shifter: eg. Gshift_rl, Gshift_rn, Gshift_rc (right ones for left, for n and for c)
  Gshift_[w][0]=shift_[w]; 
  Gshift_[w][1]=shift_[w]; 
  Gshift_[w][2]=shift_[w];
  Gshift_[w][3]=shift_[w]; // ghosts for l,c,r only but let's keep one spare
  
  // need to catch it
    if (shift_[w]==0 || shift_[w]==FULL)     shift_[w]=0xff;

  //  cogg[w][0]=0; // if we end up using these...
  //  cogg[w][1]=0;
  //  cogg[w][2]=0;
  //  cogg[w][3]=0;

  //2-where is the input bit from (LFSR, ADC type?)- can also be from another LFSR? ADC types we have in test2.c - or no inputbit
    if (inputbit[w]==0){ // LFSR from SR in LFSR[w]
      bitn = ((shift_[LFSR[w]] >> (lfsr_taps[SRlength[LFSR[w]]][0])) ^ (shift_[LFSR[w]] >> (lfsr_taps[SRlength[LFSR[w]]][1])) ^ (shift_[LFSR[w]] >> (lfsr_taps[SRlength[LFSR[w]]][2])) ^ (shift_[LFSR[w]] >> (lfsr_taps[SRlength[LFSR[w]]][3]))) & 1u; // we would use this in final...
    }
    else if (inputbit[w]==1) {// do input from type of ADC specified
      // static inline int ADC_(uint32_t reg, uint32_t length, uint32_t type){ // here we use length as number of bits max is 12 bits
      bitn=ADC_(w,SRlength[w],adctype[w]);
    }
    else bitn=0;
    
    //2.5-shifting of which bits <<
    shift_[w]=shift_[w]<<1;
  
    //3-what is routing for incoming SR bits, cycling bit
    // how we do routing table? as binary/
    route[w]=mode[w]&15; // 4 bits TESTING!
    tmp=route[w]; // route can also be another SR!
    // if route to ourself then is cycling bit but we still need to cycle <<1 above!
    for (x=0;x<4;x++){ //unroll?
      if (tmp&0x01){  
	bitrr = (Gshift_[x][w]>>SRlength[x]) & 0x01; // or other logical opp for multiple bits/accum
	Gshift_[x][w]=(Gshift_[x][w]<<1)+bitrr;  // we had x and w wrong way round - x is ghost SR number, w is our own copy for this SR
	bitn=logop(bitn,bitrr,logopp[w]); // but what if we want different logical opps for each?
    }
    tmp=tmp>>1;
    }
    // default route we don't use now...
    
    //4-what is incoming pulsin bit if any? - incoming pulse will always be ORed in
    //we have done already    //5-XOR of logic op of all bits and re-insertion
           
    if (pulsins[w]!=0){
    xx=!(GPIOC->IDR & pulsins[w]); // OR with 1 turns all to 1s 
    bitn|=xx;
    }

    doit[w]=(mode[w]>>4)&0x01; // top bit maybe
    if (doit[w] && dac[whichdoit[w]]<param) bitn^=1; //     if (tmp<adc_buffer[0]) bitn^=1; - 12 bits TO TEST!
    // can also do other things here?

    shift_[w]+=bitn;
    
    //6-DAC result for any purposes - do we output in main loop?
    // static inline int DAC_(uint32_t reg, uint32_t length, uint32_t type){ // 3 types 0,1,2 - but we can also
    dac[w]=DAC_(w, SRlength[w], dactype[w]); // TODO - add in DACtype..

    //7-pulses out if any
    // L, C and R have 2 clocks out, N has none
    
    tmp=(w<<1);
    if (bitn) *pulsoutLO[tmp]=pulsouts[tmp]; // N is just B with always zero
    else *pulsoutHI[tmp]=pulsouts[tmp];

    // follow AC scheme but we do maybe do a divide down of another bit-sofar is same! - make GENERIC
    
    lengthbit=(SRlength[w]>>1); // /2
    new_stat=(shift_[w] & (1<<lengthbit))>>lengthbit; // so that is not just a simple divide down

    if (prev_stat[w]==0 && new_stat==1) flipd[w]^=1;
    prev_stat[w]=new_stat;	
    tmp++;
    if (flipd[w]) *pulsoutLO[tmp]=pulsouts[tmp];
    else *pulsoutHI[tmp]=pulsouts[tmp];
    
    
  }//start

  //    } //4x

      // DAC output 
      // for the moment we just output from dac[2] ->[0,1,2C,3]=2 is C
      DAC_SetChannel1Data(DAC_Align_12b_R, dac[2]); // 1000/4096 * 3V3 == 0V8 
      int j = DAC_GetDataOutputValue (DAC_Channel_1); // DACout is inverting  

      // and fake CLKs TODO - top NSR is from R/3
      // DAC for normed NSR/PWM 
      tmp= dac[3]; // right hand
      tmp+=320; 
      TIM1->ARR =tmp; // what range this should be? - connect to SRlengthc
      TIM1->CCR1 = tmp/2; // pulse width

      //TODO
      // fake CLKINs for L,R,C are from Cspeed==2 - this needs to be in speeds then but...
      /*
      flipper^=1;
      if (flipper) GPIOB->BSRRH = clk_route[clkr];  // clear bits of fake_one - clkr is 7 so all of them
      // or we can set L and R from an independent SR with only CSR as clocked from here
      else   GPIOB->BSRRL=clk_route[clkr]; //  write bits       
      */

 }
