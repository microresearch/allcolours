/*

<--------------+-------^-------+-------<
               |       |       |       |
               |       |       |       |
               +-------+       +-------+

0  0  0  0  0  0  0  0  1  1  1  1  1  1  1  1  0  0  1  1  1  1  1  1  1  1  1  1  1  1  1  1  
0  0  0  0  0  0  0  0  0  1  1  1  1  1  1  1  1  0  0  1  1  1  1  1  1  1  1  1  1  1  1  1  
0  0  0  0  0  0  0  0  0  0  1  1  1  1  1  1  1  1  0  0  1  1  1  1  1  1  1  1  1  1  1  1  
0  0  0  0  0  0  0  0  0  0  0  1  1  1  1  1  1  1  1  0  0  1  1  1  1  1  1  1  1  1  1  1  
0  0  0  0  0  0  0  0  1  1  1  1  0  0  0  0  0  0  0  0  1  1  0  0  0  0  0  0  0  0  0  0  
0  0  0  0  0  0  0  0  0  1  1  1  1  0  0  0  0  0  0  0  0  1  1  0  0  0  0  0  0  0  0  0  
1  0  0  0  0  0  0  0  0  0  1  1  1  1  0  0  0  0  0  0  0  0  1  0  0  1  1  1  1  0  1  1  
1  0  0  0  0  0  0  0  0  0  0  1  1  1  1  0  0  0  0  0  0  0  0  1  0  0  1  1  1  1  0  1  
0  0  0  0  0  0  0  0  0  0  0  0  1  1  1  1  0  0  0  0  0  0  0  1  1  1  1  0  0  1  0  1  
0  0  0  0  0  0  0  0  0  0  0  0  0  1  1  1  1  0  0  0  0  0  0  0  1  1  1  1  0  0  1  0  
0  0  0  0  0  0  0  0  0  0  0  0  0  0  1  1  1  1  0  0  0  0  0  0  0  1  1  1  1  0  0  1  
0  0  0  0  0  0  0  0  0  0  0  0  0  0  0  1  1  1  1  0  0  0  0  0  0  0  1  1  1  1  0  0  
0  0  0  0  0  0  0  0  0  0  0  0  0  0  0  0  1  1  1  1  0  0  0  0  0  0  0  1  1  1  1  0  
0  0  0  0  0  0  0  0  0  0  0  0  0  0  0  0  0  1  1  1  1  0  0  0  0  0  0  0  1  1  1  1  
0  0  0  0  0  0  0  0  0  0  0  0  0  0  0  0  0  0  1  1  1  1  0  0  0  0  0  0  0  1  1  1  
0  0  0  0  0  0  0  0  1  1  1  1  1  1  1  1  1  1  1  0  0  0  0  1  1  1  1  1  1  1  0  0  
1  0  0  0  0  0  0  0  1  0  0  0  0  0  0  0  0  0  0  0  1  1  1  0  0  1  1  1  1  0  1  0  
1  0  0  0  0  0  0  0  1  0  1  1  1  1  1  1  1  1  1  1  1  0  0  0  1  1  0  0  0  0  1  0  
1  0  0  0  0  0  0  0  1  0  1  0  0  0  0  0  0  0  0  0  0  0  1  1  1  0  0  1  1  1  1  0  
1  0  0  0  0  0  0  0  0  1  0  1  0  0  0  0  0  0  0  0  0  0  0  1  1  1  0  0  1  1  1  1  

TODO:
////

  */ 

//#include "main.h"
#include "stm32f4xx.h"
#include "stm32f4xx_dac.h"
#include "stm32f4xx_gpio.h"
#include "stm32f4xx_adc.h"
#include "stm32f4xx_dma.h"
#include "stm32f4xx_rcc.h"
#include "stm32f4xx_spi.h"
#include "stm32f4xx_exti.h"
#include "stm32f4xx_tim.h"
#include "misc.h"
#include "adc.h"

/////////////////////
extern __IO uint16_t adc_buffer[12];
float LPF_Beta = 0.4; // 0<ß<1


#define FROZENSPEED 1024 // 
#define MAXVALUE 4095
#define SMOOTHINGS 512 // we can hold 65536 of our 16 bit ADC values...speed
uint32_t cc=0, totc=0, smoothc[SMOOTHINGS];
uint32_t ll=0, totl=0, smoothl[SMOOTHINGS];
uint32_t rr=0, totr=0, smoothr[SMOOTHINGS];
uint32_t nn=0, totn=0, smoothn[SMOOTHINGS];

uint16_t modec, moden, model, moder;
uint16_t lastmodec, lastmoden, lastmodel, lastmoder;
uint16_t lastlastmodec, lastlastmoden, lastlastmodel, lastlastmoder;

volatile uint32_t intflag[4]={0,0,0,0}; // interrupt flag...

// for generic CLK fake puls routing
//LSRCLK-pulse9=PB12, RSRCLK-pulse10=PB13, CSRCLCK-pulse11=PB14
// 000,001,010,011,100,101,110,111
static uint32_t clk_route[8]={0,
			      (1<<12),
			      (1<<13),
			      (1<<12) | (1<<13),
			      (1<<14),
			      (1<<12) | (1<<14),
			      (1<<14) | (1<<13),
			      (1<<12) | (1<<13) | (1<<14)
};

// what are pulse ins?
// only for left and right! PC7 is RSR, PC8 is LSR
// generic table and all on GPIOC
static uint32_t pulsins[4]={0,1<<8,0,1<<7}; //N,L,C,R

// what are pulse outs?
// L1-PB2, L2-PC15, R1-PB3, R2-PA11, C1-PB4, C2-PA12
static uint32_t pulsouts[8]={0,0, 1<<2,1<<15, 1<<4,1<<12, 1<<3,1<<11};

// test pointering WORKS! so we can have array of pointers for easier bit access
//also we can make bit access (eg. GPIOC->IDR & 0x0010 - can we access register as pointer TEST???, counters speed etc. all arrays 0,1,2,3
//  volatile uint32_t *bitz;
//  bitz=&(GPIOC->IDR);

volatile uint16_t *pulsoutHI[10]={&(GPIOB->BSRRL), &(GPIOB->BSRRL), &(GPIOB->BSRRL), &(GPIOC->BSRRL), &(GPIOB->BSRRL), &(GPIOA->BSRRL), &(GPIOB->BSRRL), &(GPIOA->BSRRL) };
//                                  0              0              PB2            PC15           PB4            PA12           PB3            PA11 
volatile uint16_t *pulsoutLO[10]={&(GPIOB->BSRRH), &(GPIOB->BSRRH), &(GPIOB->BSRRH), &(GPIOC->BSRRH), &(GPIOB->BSRRH), &(GPIOA->BSRRH), &(GPIOB->BSRRH), &(GPIOA->BSRRH) }; // both are 16 bit registers

static uint32_t lookuplenall[32]={3, 3, 3, 3, 4,5,6,7,8,9,10,11,12,13,14,15,16,17,18,19,20,21,22,23,24,25,26,27,28,29,30,31};

static uint8_t bitsz[256]={0, 1, 1, 2, 1, 2, 2, 3, 1, 2, 2, 3, 2,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 7, 8}; // this is for 8 bits

static uint32_t rightshift[32]={0,0,0,0, 0,0,0,0, 0,0,0,0, // first 12 bits
				1,2,3,4, 5,6,7,8, 9,10,11,12, 13,14,15,16, 17,18,19,20};

static uint32_t leftshift[32]= {11,10,9, 8,7,6,5, 4,3,2,1,
				0,0,0,0, 0,0,0,0, 0,0,0,0, 0,0,0,0, 0,0,0,0};

// fixed masks 31/8/2021

static uint32_t invmasky[32]={//0,0,0, // skip all zeroes or all ones ??? skip all ones

  //0b11111111111111111111111111111111,
0b11111111111111111111111111111110,
0b11111111111111111111111111111100,
0b11111111111111111111111111111000,
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0b10000000000000000000000000000000,
0b00000000000000000000000000000000
};

  
static uint32_t masky[32]={//0,0,0, // skip all zeroes or all ones ??? all 0
			   0b00000000000000000000000000000001,			  
			   0b00000000000000000000000000000011,			  
			   0b00000000000000000000000000000111,			  
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			   0b11111111111111111111111111111111,
};

static uint32_t othermasky[32]={  // skip all zeroes or all ones ???
  //  0b00000000000000000000000000000000,
  0b10000000000000000000000000000000,
  0b11000000000000000000000000000000,
  0b11100000000000000000000000000000,
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  0b11111111111111111111111111111111,
};


// TODO: test much greater range of slow speeds - and stop indicator/value at end -> first establish basic speed for all modes and then
// we can do this...

static uint16_t logger[1024]={1, 1, 1, 1, 1, 1, 1, 1, 1, 1, 1, 1, 1,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 1017, 1024}; //

// array for taps
// eg. 32-bit Galois LFSR with taps at 32, 30, 26, 25. Sequence length is 4294967295. 0 is a lock-up state.  -- minus one here - 31, 29, 25, 24
// bith= ((shift_registerh >> 31) ^ (shift_registerh >> 29) ^ (shift_registerh >> 25) ^ (shift_registerh >> 24)) & 1u; // 32 is 31, 29, 25, 24
// from: http://courses.cse.tamu.edu/walker/csce680/lfsr_table.pdf
// and reworked for length in test.c -> not so if we revert to basic code...
// note that we can have 2 mirrored with [n, A, B, C] -> [n, n-C, n-B, n-A] - maybe for LF to hF!

static uint8_t lfsr_taps[32][4] = {
        {0, 0, 0, 0},
        {0, 0, 0, 0},
        {0, 0, 0, 0},
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        {31, 29, 25, 24},
  };

static uint8_t ghost_tapsL[32][4] = { // left hand path
        {0, 0, 0, 0},
        {0, 0, 0, 0},
        {0, 0, 0, 0},
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        {31, 29, 25, 24},
  };


static uint8_t lfsr_taps_mirrored[32][4] = {
        {0, 0, 0, 0},
        {0, 0, 0, 0},
        {0, 1, 1, 1},
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        {31, 6, 5, 1},
	 };

static uint8_t ghost_tapsR[32][4] = { // right hands path
        {0, 0, 0, 0},
        {0, 0, 0, 0},
        {0, 1, 1, 1},
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        {31, 6, 5, 1},
	 };

static uint32_t countbts[4096]={0, 1, 1, 2, 1, 2, 2, 3, 1, 2, 2, 3, 2,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 11, 12};

uint32_t divy[12]={4096, 2048, 1365, 1024, 819, 682, 585, 512, 455, 409, 372, 341};

/// for DAC we can also just pass in shiftreg itself as is quicker - but we also need number
static inline uint32_t DAC_(uint32_t reg, uint32_t length, uint32_t type, uint32_t which){ // 3 types 0,1,2 - but we can also add more types for spacings with array of spacers (which we did have somewhere
  uint32_t y,x=0;
  static float SmoothData[4]={0.0, 0.0, 0.0, 0.0};

  if (type==0){ // standard bit DAC for x bits
    if (length>3 && length<32) {
      x=((reg & masky[length-3])>>(rightshift[length-3]))<<leftshift[length-3];
  }
  }
  else if (type==1){
      // equivalent bit DAC for x bits - we need a table for this!
      // or more like set of tables for each bit
      // and we need divide highest but number - eg. for 8 bits we have max 8 (all 1s) - max 12 bits DAC is 4096 4096/8=512 4096/12=341
      // we can have another table for this - but just taking maybe max of 12 bits otherwise lookup is too long (max 12 bits=4096)
	if (length>11) length=11;
	x=countbts[reg&masky[length]]; // lower length bits only
	y=divy[length]; // we can just have look up for this as is only 1->12
	  x*=y;
  }
  else { // one bit audio
    // top bit
    y=(reg>>length)&1;
    if (y==1) x=4095;
    else x=0;
    SmoothData[which] = SmoothData[which] - (LPF_Beta * (SmoothData[which] - x)); // how do we adjust beta for speed?
    x=(int)SmoothData[which];
  }
  return x;
}

///////////////////////////////////////////////////////////////////////// 

#define delay()						 do {	\
    register unsigned int ix;					\
    for (ix = 0; ix < 1000; ++ix)				\
      __asm__ __volatile__ ("nop\n\t":::"memory");		\
  } while (0)

#define delayy()						 do {	\
    register unsigned int ix;					\
    for (ix = 0; ix < 10000000; ++ix)				\
      __asm__ __volatile__ ("nop\n\t":::"memory");		\
  } while (0)

void NMI_Handler(void)
{
}

void HardFault_Handler(void)
{
  /* Go to infinite loop when Hard Fault exception occurs */
  while (1)
  {
  }
}

void MemManage_Handler(void)
{
  /* Go to infinite loop when Memory Manage exception occurs */
  while (1)
  {
  }
}

void BusFault_Handler(void)
{
  /* Go to infinite loop when Bus Fault exception occurs */
  while (1)
  {
  }
}

void UsageFault_Handler(void)
{
  /* Go to infinite loop when Usage Fault exception occurs */
  while (1)
  {
  }
}

void SVC_Handler(void)
{
}

void DebugMon_Handler(void)
{
}

void PendSV_Handler(void)
{
}

void EXTI4_IRQHandler(void){ // working NSR 
  uint32_t tmp, tmpp;
if (EXTI_GetITStatus(EXTI_Line4) != RESET) {
  intflag[0]=1; //NSR
  EXTI_ClearITPendingBit(EXTI_Line4);
 }
 }

void EXTI9_5_IRQHandler(void){ // PC5 RSR works and PB6 LSR share same line but both work out
  uint32_t tmp, tmpp;
  uint16_t j, bit, xx, x;
  uint32_t lengthbitl=15, new_statl, new_statr,new_statc, lengthbitc=15, lengthbitr=15; // for 2nd bit on lsr, rsr and csr
  
  // added PB7 now for CSRCLKIN CSR which moved from PC3!!!
  // CSR: PC3->now PB7, NSR: PC4, RSR: PC5, LSR: PB6
  
  
  if (EXTI_GetITStatus(EXTI_Line5) != RESET) { //RSR  
    intflag[3]=1; //RSR
    EXTI_ClearITPendingBit(EXTI_Line5);
 }

  if (EXTI_GetITStatus(EXTI_Line6) != RESET) { //LSR
    intflag[1]=1; //LSR
    EXTI_ClearITPendingBit(EXTI_Line6);
 } 

  if (EXTI_GetITStatus(EXTI_Line7) != RESET) {// CSR
    intflag[2]=1; //CSR
    EXTI_ClearITPendingBit(EXTI_Line7);
 } 

}

uint16_t leaks(uint16_t x, uint16_t y, uint16_t prob){ // try lazy, stickyt, leaky, decaying logic here...
  static uint16_t timer=0;
  uint16_t z;
  // p as probability or time
  // keep track of how many times this is called and flip bit

  // or we can track bits recording their position for a certain lifespan
  // one bit per SR is tracked and lost... so would be leakNSR for example for that bit
  
  // but that is too deterministic... but if we share timers or if timer is across different speeds
  //  prob=1;
  // leaky XOR to test
  if (prob>31) prob=31;
  
  if (x^y==0) return 0;
  shift_registerR=(shift_registerR<<1)+z; // we are shifting left << so bit 31 is out last one
  if ((shift_registerR&masky[prob])==0) return 1;
  //  else if (rand()%prob==0) return 1;
  return 0;
  
  /*  timer++;
  if (timer>p){
    timer=0;
    d^=1;
    }*/
}

void TIM4_IRQHandler(void) 
// HERE we do speed and modes ALL TODO AS ARRAYS

{
  uint32_t temp;
  volatile static uint16_t tmp;

  TIM_ClearITPendingBit(TIM4, TIM_IT_Update); 

  /*  
      tmp^=1;
      if (tmp) GPIOB->BSRRH = (1)<<4;  // clear bits PB2
      else   GPIOB->BSRRL=(1)<<4; //  write bits   
  */

    // map ADCs: note all modes are inverted

    // 0: nspd, 1: nlen, 2: nmode
    // 3: lspd, 4: llen, 5: lmode
    // 6: rspd, 7: rlen, 8: rmode // adc6 fixed hw
    // 9: cspd, 10: clen, 11: cmode

  // deal with PWM for normings (always follows speedn - or now we think it should follow DAC out)
  
  // double-check inversion of modes? as doesn't seem so!
  // modes are NOT inverted!
  
  //moden
  temp=(adc_buffer[2]+lastlastmoden+lastmoden)/3; //smoothing necessary for higher speeds - TEST!
  lastlastmoden=lastmoden;
  lastmoden=temp;
  moden=(temp>>6); // 64 modes = 6 bits  

  // modec
  temp=(adc_buffer[11]+lastlastmodec+lastmodec)/3; //smoothing necessary for higher speeds - TEST!
  lastlastmodec=lastmodec;
  lastmodec=temp;
  modec=(temp>>6); // 64 modes = 6 bits  

  // model
  temp=(adc_buffer[5]+lastlastmodel+lastmodel)/3; //smoothing necessary for higher speeds - TEST!
  lastlastmodel=lastmodel;
  lastmodel=temp;
  model=(temp>>6); // 64 modes = 6 bits  

  // moder
  temp=(adc_buffer[8]+lastlastmoder+lastmoder)/3; //smoothing necessary for higher speeds - TEST!
  lastlastmoder=lastmoder;
  lastmoder=temp;
  moder=(temp>>6); // 64 modes = 6 bits  
   
  // speedn
  totn=totn-smoothn[nn];
  smoothn[nn]=adc_buffer[0];
  totn+=smoothn[nn];
  nn++;
  if (nn>=SMOOTHINGS) nn=0;
  temp=totn/SMOOTHINGS;  
  speedn=logger[temp>>2];

  // speedl
  totl=totl-smoothl[ll];
  smoothl[ll]=adc_buffer[3];
  totl+=smoothl[ll];
  ll++;
  if (ll>=SMOOTHINGS) ll=0;
  temp=totl/SMOOTHINGS;  
  speedl=logger[temp>>2];

  // speedr
  totr=totr-smoothr[rr];
  smoothr[rr]=adc_buffer[6];
  totr+=smoothr[rr];
  rr++;
  if (rr>=SMOOTHINGS) rr=0;
  temp=totr/SMOOTHINGS;  
  speedr=logger[temp>>2];

    // speedc
  totc=totc-smoothc[cc];
  smoothc[cc]=adc_buffer[9];
  totc+=smoothc[cc];
  cc++;
  if (cc>=SMOOTHINGS) cc=0;
  temp=totc/SMOOTHINGS;  
  speedc=logger[temp>>2];

  
  
  // lens from 4 to 32
  // test now 1/9/2021 constraining to odd numbers and we can go small...

  temp=31-(adc_buffer[1]>>7); // 12 bits to 5 bits 
  SRlengthn=lookuplenall[temp];

  temp=31-(adc_buffer[4]>>7); // 12 bits to 5 bits 
  SRlengthl=lookuplenall[temp];

  temp=31-(adc_buffer[7]>>7); // 12 bits to 5 bits 
  SRlengthr=lookuplenall[temp];

  temp=31-(adc_buffer[10]>>7); // 12 bits to 5 bits 
  SRlengthc=lookuplenall[temp];

  /*
  SRlengthl=31-(adc_buffer[4]>>7); // 12 bits to 5 bits
  if (SRlengthl<4) SRlengthl=4;

  SRlengthr=31-(adc_buffer[7]>>7); // 12 bits to 5 bits
  if (SRlengthr<4) SRlengthr=4;

  SRlengthc=31-(adc_buffer[10]>>7); // 12 bits to 5 bits
  if (SRlengthc<4) SRlengthc=4; // can we have lengths down to 0=1
  */  

}

void TIM2_IRQHandler(void) // running with period=1024, prescale=32 at 2KHz - how fast can we run this?
// period 32, prescaler 8 = toggle of 104 KHz
// 4 and 4 we go up to 800 KHz
{
  static uint32_t flipper=0, countercc=0, clkr=7;
  static volatile uint32_t k=0,ll=0, n=0, accum, cnt=0, sl=0;
  static volatile int16_t integrator=0, oldValue=0, tmp=0, tmpp=0;
  uint32_t lengthbitl=15, new_statl, new_statr, new_statc, lengthbitc=15, lengthbitr=15; // for 2nd bit on lsr, rsr and csr

  uint16_t j, bit, xx, x;
  uint64_t longer;
  uint32_t shift_register;
  static uint32_t dac_; 
  int16_t tmpt;
    //low pass test
  static float SmoothData=0.0;
  TIM_ClearITPendingBit(TIM2, TIM_IT_Update); // needed
    
}
